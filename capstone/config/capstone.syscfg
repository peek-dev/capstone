/**
 * @cliArgs --board "/ti/boards/LP_MSPM0G3507" --product "mspm0_sdk@2.02.00.05"
 * @versions {"tool":"1.21.1+3772"}
 */
scripting.excludeFromBuild("device_linker.lds");
scripting.excludeFromBuild("device.cmd.genlibs");
scripting.excludeFromBuild("device.lds.genlibs");
scripting.excludeFromBuild("Event.dot");

/**
 * Import the modules used in this configuration.
 */
const ADC12         = scripting.addModule("/ti/driverlib/ADC12", {}, false);
const ADC121        = ADC12.addInstance();
const Board         = scripting.addModule("/ti/driverlib/Board");
const GPIO          = scripting.addModule("/ti/driverlib/GPIO", {}, false);
const GPIO1         = GPIO.addInstance();
const GPIO2         = GPIO.addInstance();
const SYSCTL        = scripting.addModule("/ti/driverlib/SYSCTL");
const ProjectConfig = scripting.addModule("/ti/project_config/ProjectConfig");

/**
 * Write custom configuration values to the imported modules.
 */
const divider7       = system.clockTree["PLL_PDIV"];
divider7.divideValue = 2;

const divider9       = system.clockTree["UDIV"];
divider9.divideValue = 2;

const multiplier2         = system.clockTree["PLL_QDIV"];
multiplier2.multiplyValue = 5;

const mux8       = system.clockTree["HSCLKMUX"];
mux8.inputSelect = "HSCLKMUX_SYSPLL2X";

ADC121.$name                      = "ADC_0";
ADC121.sampClkSrc                 = "DL_ADC12_CLOCK_ULPCLK";
ADC121.adcMem0chansel             = "DL_ADC12_INPUT_CHAN_2";
ADC121.sampleTime0                = "1 us";
ADC121.enabledInterrupts          = ["DL_ADC12_INTERRUPT_MEM0_RESULT_LOADED"];
ADC121.powerDownMode              = "DL_ADC12_POWER_DOWN_MODE_MANUAL";
ADC121.adcMem0_name               = "ChessSquare";
ADC121.peripheral.$assign         = "ADC0";
ADC121.peripheral.adcPin2.$assign = "boosterpack.2";
ADC121.adcPin2Config.$name        = "test";


GPIO1.$name                          = "MUX_GPIO";
GPIO1.associatedPins.create(9);
GPIO1.associatedPins[0].$name        = "PIN_R_A0";
GPIO1.associatedPins[0].pin.$assign  = "boosterpack.40";
GPIO1.associatedPins[1].$name        = "PIN_R_A1";
GPIO1.associatedPins[1].pin.$assign  = "boosterpack.39";
GPIO1.associatedPins[2].$name        = "PIN_R_A2";
GPIO1.associatedPins[2].pin.$assign  = "boosterpack.38";
GPIO1.associatedPins[3].$name        = "PIN_C_A0";
GPIO1.associatedPins[3].initialValue = "SET";
GPIO1.associatedPins[3].pin.$assign  = "boosterpack.37";
GPIO1.associatedPins[4].$name        = "PIN_C_A1";
GPIO1.associatedPins[4].pin.$assign  = "boosterpack.36";
GPIO1.associatedPins[5].$name        = "PIN_C_A2";
GPIO1.associatedPins[5].pin.$assign  = "boosterpack.35";
GPIO1.associatedPins[6].$name        = "PIN_MODE0";
GPIO1.associatedPins[6].initialValue = "SET";
GPIO1.associatedPins[6].pin.$assign  = "boosterpack.14";
GPIO1.associatedPins[7].$name        = "PIN_MODE1";
GPIO1.associatedPins[7].initialValue = "SET";
GPIO1.associatedPins[7].pin.$assign  = "boosterpack.32";
GPIO1.associatedPins[8].$name        = "PIN_REPOS";
GPIO1.associatedPins[8].pin.$assign  = "boosterpack.11";

GPIO2.$name                          = "LED_GPIO";
GPIO2.associatedPins[0].$name        = "LED1";
GPIO2.associatedPins[0].initialValue = "SET";
GPIO2.associatedPins[0].pin.$assign  = "j19_expansion.9";


/**
 * Pinmux solution for unlocked pins/peripherals. This ensures that minor changes to the automatic solver in a future
 * version of the tool will not impact the pinmux you originally saw.  These lines can be completely deleted in order to
 * re-solve from scratch.
 */
Board.peripheral.$suggestSolution          = "DEBUGSS";
Board.peripheral.swclkPin.$suggestSolution = "j25_expansion.16";
Board.peripheral.swdioPin.$suggestSolution = "j25_expansion.14";
SYSCTL.peripheral.$suggestSolution         = "SYSCTL";
