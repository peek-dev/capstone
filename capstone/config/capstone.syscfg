/**
 * These arguments were used when this file was generated. They will be automatically applied on subsequent loads
 * via the GUI or CLI. Run CLI with '--help' for additional information on how to override these arguments.
 * @cliArgs --board "/ti/boards/LP_MSPM0G3507" --product "mspm0_sdk@2.02.00.05"
 * @v2CliArgs --board "/ti/boards/LP_MSPM0G3507" --product "mspm0_sdk@2.02.00.05"
 * @versions {"tool":"1.21.1+3772"}
 */
scripting.excludeFromBuild("device_linker.lds");
scripting.excludeFromBuild("device.cmd.genlibs");
scripting.excludeFromBuild("device.lds.genlibs");
scripting.excludeFromBuild("Event.dot");

/**
 * Import the modules used in this configuration.
 */
const ADC12         = scripting.addModule("/ti/driverlib/ADC12", {}, false);
const ADC121        = ADC12.addInstance();
const Board         = scripting.addModule("/ti/driverlib/Board");
const GPIO          = scripting.addModule("/ti/driverlib/GPIO", {}, false);
const GPIO1         = GPIO.addInstance();
const GPIO2         = GPIO.addInstance();
const GPIO3         = GPIO.addInstance();
const SPI           = scripting.addModule("/ti/driverlib/SPI", {}, false);
const SPI1          = SPI.addInstance();
const SPI2          = SPI.addInstance();
const SYSCTL        = scripting.addModule("/ti/driverlib/SYSCTL");
const TIMER         = scripting.addModule("/ti/driverlib/TIMER", {}, false);
const TIMER1        = TIMER.addInstance();
const TIMER2        = TIMER.addInstance();
const UART          = scripting.addModule("/ti/driverlib/UART", {}, false);
const UART1         = UART.addInstance();
const ProjectConfig = scripting.addModule("/ti/project_config/ProjectConfig");

/**
 * Write custom configuration values to the imported modules.
 */
const divider7       = system.clockTree["PLL_PDIV"];
divider7.divideValue = 2;

const divider9       = system.clockTree["UDIV"];
divider9.divideValue = 2;

const multiplier2         = system.clockTree["PLL_QDIV"];
multiplier2.multiplyValue = 5;

const mux8       = system.clockTree["HSCLKMUX"];
mux8.inputSelect = "HSCLKMUX_SYSPLL2X";

ADC121.enableDMA           = false;
ADC121.sampClkSrc          = "DL_ADC12_CLOCK_ULPCLK";
ADC121.$name               = "ADC_0";
ADC121.sampleTime0         = "62.5ns";
ADC121.adcMem0avgen        = true;
ADC121.hwNumerator         = "DL_ADC12_HW_AVG_NUM_ACC_4";
ADC121.enabledInterrupts   = ["DL_ADC12_INTERRUPT_MEM0_RESULT_LOADED"];
ADC121.hwDenominator       = "DL_ADC12_HW_AVG_DEN_DIV_BY_4";
ADC121.adcMem0chansel      = "DL_ADC12_INPUT_CHAN_2";
ADC121.adcMem0_name        = "ChessSquare";
ADC121.peripheral.$assign  = "ADC0";
ADC121.adcPin2Config.$name = "ti_driverlib_gpio_GPIOPinGeneric6";


GPIO1.$name                         = "MUX_GPIO";
GPIO1.associatedPins.create(6);
GPIO1.associatedPins[0].$name       = "PIN_R_A0";
GPIO1.associatedPins[0].pin.$assign = "boosterpack.40";
GPIO1.associatedPins[1].$name       = "PIN_R_A1";
GPIO1.associatedPins[1].pin.$assign = "boosterpack.39";
GPIO1.associatedPins[2].$name       = "PIN_R_A2";
GPIO1.associatedPins[2].pin.$assign = "boosterpack.38";
GPIO1.associatedPins[3].$name       = "PIN_C_A0";
GPIO1.associatedPins[3].pin.$assign = "boosterpack.37";
GPIO1.associatedPins[4].$name       = "PIN_C_A1";
GPIO1.associatedPins[4].pin.$assign = "boosterpack.36";
GPIO1.associatedPins[5].$name       = "PIN_C_A2";
GPIO1.associatedPins[5].pin.$assign = "boosterpack.35";

GPIO2.$name                               = "BUTTON_GPIO";
GPIO2.associatedPins.create(7);
GPIO2.associatedPins[0].$name             = "PIN_HINT";
GPIO2.associatedPins[0].direction         = "INPUT";
GPIO2.associatedPins[0].interruptEn       = true;
GPIO2.associatedPins[0].interruptPriority = "3";
GPIO2.associatedPins[0].polarity          = "RISE";
GPIO2.associatedPins[0].pin.$assign       = "boosterpack.8";
GPIO2.associatedPins[1].direction         = "INPUT";
GPIO2.associatedPins[1].$name             = "PIN_UNDO";
GPIO2.associatedPins[1].interruptEn       = true;
GPIO2.associatedPins[1].interruptPriority = "3";
GPIO2.associatedPins[1].polarity          = "RISE";
GPIO2.associatedPins[1].pin.$assign       = "boosterpack.9";
GPIO2.associatedPins[2].direction         = "INPUT";
GPIO2.associatedPins[2].$name             = "PIN_START_RESTART";
GPIO2.associatedPins[2].interruptEn       = true;
GPIO2.associatedPins[2].polarity          = "RISE";
GPIO2.associatedPins[2].interruptPriority = "3";
GPIO2.associatedPins[2].pin.$assign       = "boosterpack.28";
GPIO2.associatedPins[3].$name             = "PIN_PAUSE";
GPIO2.associatedPins[3].direction         = "INPUT";
GPIO2.associatedPins[3].interruptEn       = true;
GPIO2.associatedPins[3].interruptPriority = "3";
GPIO2.associatedPins[3].polarity          = "RISE";
GPIO2.associatedPins[3].pin.$assign       = "boosterpack.10";
GPIO2.associatedPins[4].$name             = "PIN_CLOCK_MODE";
GPIO2.associatedPins[4].direction         = "INPUT";
GPIO2.associatedPins[4].interruptEn       = true;
GPIO2.associatedPins[4].interruptPriority = "3";
GPIO2.associatedPins[4].polarity          = "RISE";
GPIO2.associatedPins[4].pin.$assign       = "boosterpack.29";
GPIO2.associatedPins[5].$name             = "PIN_BLACK_MOVE";
GPIO2.associatedPins[5].direction         = "INPUT";
GPIO2.associatedPins[5].interruptEn       = true;
GPIO2.associatedPins[5].interruptPriority = "3";
GPIO2.associatedPins[5].polarity          = "RISE";
GPIO2.associatedPins[5].pin.$assign       = "boosterpack.27";
GPIO2.associatedPins[6].$name             = "PIN_WHITE_MOVE";
GPIO2.associatedPins[6].direction         = "INPUT";
GPIO2.associatedPins[6].interruptEn       = true;
GPIO2.associatedPins[6].interruptPriority = "3";
GPIO2.associatedPins[6].polarity          = "RISE";
GPIO2.associatedPins[6].pin.$assign       = "boosterpack.30";

GPIO3.$name                          = "MISC_GPIO";
GPIO3.associatedPins.create(2);
GPIO3.associatedPins[0].$name        = "CLOCK_LOAD";
GPIO3.associatedPins[0].pin.$assign  = "boosterpack.12";
GPIO3.associatedPins[1].$name        = "BUTTON_ENABLE";
GPIO3.associatedPins[1].initialValue = "SET";
GPIO3.associatedPins[1].pin.$assign  = "boosterpack.7";

SPI1.enableDMAEvent1                    = false;
SPI1.enableDMAEvent2                    = false;
SPI1.frameFormat                        = "MOTO3";
SPI1.direction                          = "PICO";
SPI1.enablePacking                      = true;
SPI1.$name                              = "LED_SPI";
SPI1.dataSize                           = 16;
SPI1.overrideRetention                  = true;
SPI1.targetBitRate                      = 16000000;
SPI1.peripheral.$assign                 = "SPI0";
SPI1.peripheral.sclkPin.$assign         = "boosterpack.32";
SPI1.peripheral.mosiPin.$assign         = "boosterpack.18";
SPI1.sclkPinConfig.direction            = scripting.forceWrite("OUTPUT");
SPI1.sclkPinConfig.onlyInternalResistor = scripting.forceWrite(false);
SPI1.sclkPinConfig.passedPeripheralType = scripting.forceWrite("Digital");
SPI1.sclkPinConfig.$name                = "ti_driverlib_gpio_GPIOPinGeneric0";
SPI1.mosiPinConfig.direction            = scripting.forceWrite("OUTPUT");
SPI1.mosiPinConfig.hideOutputInversion  = scripting.forceWrite(false);
SPI1.mosiPinConfig.onlyInternalResistor = scripting.forceWrite(false);
SPI1.mosiPinConfig.passedPeripheralType = scripting.forceWrite("Digital");
SPI1.mosiPinConfig.$name                = "ti_driverlib_gpio_GPIOPinGeneric1";

SPI2.enableDMAEvent1                    = false;
SPI2.enableDMAEvent2                    = false;
SPI2.chipSelect                         = [];
SPI2.frameFormat                        = "MOTO3";
SPI2.dataSize                           = 16;
SPI2.direction                          = "PICO";
SPI2.$name                              = "CLOCK_SPI";
SPI2.overrideRetention                  = true;
SPI2.phase                              = "1";
SPI2.targetBitRate                      = 1000000;
SPI2.peripheral.$assign                 = "SPI1";
SPI2.peripheral.sclkPin.$assign         = "boosterpack.11";
SPI2.peripheral.mosiPin.$assign         = "boosterpack.15";
SPI2.sclkPinConfig.direction            = scripting.forceWrite("OUTPUT");
SPI2.sclkPinConfig.onlyInternalResistor = scripting.forceWrite(false);
SPI2.sclkPinConfig.passedPeripheralType = scripting.forceWrite("Digital");
SPI2.sclkPinConfig.$name                = "ti_driverlib_gpio_GPIOPinGeneric4";
SPI2.mosiPinConfig.direction            = scripting.forceWrite("OUTPUT");
SPI2.mosiPinConfig.hideOutputInversion  = scripting.forceWrite(false);
SPI2.mosiPinConfig.onlyInternalResistor = scripting.forceWrite(false);
SPI2.mosiPinConfig.passedPeripheralType = scripting.forceWrite("Digital");
SPI2.mosiPinConfig.$name                = "ti_driverlib_gpio_GPIOPinGeneric5";


TIMER1.$name              = "SENSOR_DELAY_TIMER";
TIMER1.timerPeriod        = "150 us";
TIMER1.interrupts         = ["ZERO"];
TIMER1.peripheral.$assign = "TIMG0";

TIMER2.$name              = "LCD_DELAY_LOAD";
TIMER2.timerPeriod        = "1 us";
TIMER2.interrupts         = ["ZERO"];
TIMER2.peripheral.$assign = "TIMG6";

UART1.targetBaudRate                   = 115200;
UART1.$name                            = "RPI_UART";
UART1.enabledInterrupts                = ["RX"];
UART1.enableFIFO                       = true;
UART1.overrideRetention                = true;
UART1.rxFifoThreshold                  = "DL_UART_RX_FIFO_LEVEL_FULL";
UART1.peripheral.$assign               = "UART0";
UART1.peripheral.rxPin.$assign         = "boosterpack.33";
UART1.peripheral.txPin.$assign         = "boosterpack.34";
UART1.txPinConfig.direction            = scripting.forceWrite("OUTPUT");
UART1.txPinConfig.hideOutputInversion  = scripting.forceWrite(false);
UART1.txPinConfig.onlyInternalResistor = scripting.forceWrite(false);
UART1.txPinConfig.passedPeripheralType = scripting.forceWrite("Digital");
UART1.txPinConfig.$name                = "ti_driverlib_gpio_GPIOPinGeneric2";
UART1.rxPinConfig.hideOutputInversion  = scripting.forceWrite(false);
UART1.rxPinConfig.onlyInternalResistor = scripting.forceWrite(false);
UART1.rxPinConfig.passedPeripheralType = scripting.forceWrite("Digital");
UART1.rxPinConfig.$name                = "ti_driverlib_gpio_GPIOPinGeneric3";

/**
 * Pinmux solution for unlocked pins/peripherals. This ensures that minor changes to the automatic solver in a future
 * version of the tool will not impact the pinmux you originally saw.  These lines can be completely deleted in order to
 * re-solve from scratch.
 */
ADC121.peripheral.adcPin2.$suggestSolution = "boosterpack.2";
Board.peripheral.$suggestSolution          = "DEBUGSS";
Board.peripheral.swclkPin.$suggestSolution = "j25_expansion.16";
Board.peripheral.swdioPin.$suggestSolution = "j25_expansion.14";
SYSCTL.peripheral.$suggestSolution         = "SYSCTL";
